## Documentation/devicetree/bindings/common-properties.txt
```
Common properties

The ePAPR specification does not define any properties related to hardware
byteswapping, but endianness issues show up frequently in porting Linux to
different machine types.  This document attempts to provide a consistent
way of handling byteswapping across drivers.

Optional properties:
 - big-endian: Boolean; force big endian register accesses
   unconditionally (e.g. ioread32be/iowrite32be).  Use this if you
   know the peripheral always needs to be accessed in BE mode.
 - little-endian: Boolean; force little endian register accesses
   unconditionally (e.g. readl/writel).  Use this if you know the
   peripheral always needs to be accessed in LE mode.  This is the
   default.
 - native-endian: Boolean; always use register accesses matched to the
   endianness of the kernel binary (e.g. LE vmlinux -> readl/writel,
   BE vmlinux -> ioread32be/iowrite32be).  In this case no byteswaps
   will ever be performed.  Use this if the hardware "self-adjusts"
   register endianness based on the CPU's configured endianness.

Note that regmap, in contrast, defaults to native-endian.  But this
document is targeted for existing drivers, most of which currently use
readl/writel because they expect to be accessing PCI/PCIe devices rather
than memory-mapped SoC peripherals.  Since the readl/writel accessors
perform a byteswap on BE systems, this means that the drivers in question
are implicitly "little-endian".

Examples:
Scenario 1 : CPU in LE mode & device in LE mode.
dev: dev@40031000 {
	      compatible = "name";
	      reg = <0x40031000 0x1000>;
	      ...
	      native-endian;
};

Scenario 2 : CPU in LE mode & device in BE mode.
dev: dev@40031000 {
	      compatible = "name";
	      reg = <0x40031000 0x1000>;
	      ...
	      big-endian;
};

Scenario 3 : CPU in BE mode & device in BE mode.
dev: dev@40031000 {
	      compatible = "name";
	      reg = <0x40031000 0x1000>;
	      ...
	      native-endian;
};

Scenario 4 : CPU in BE mode & device in LE mode.
dev: dev@40031000 {
	      compatible = "name";
	      reg = <0x40031000 0x1000>;
	      ...
	      little-endian;
};
```

## Documentation/devicetree/bindings/mips/brcm/cm-dsl.txt
```
* Broadcom cable/DSL platforms

SoCs:

Required properties:
- compatible: "brcm,bcm3384", "brcm,bcm33843", "brcm,bcm3384-viper",
  "brcm-bcm33843-viper"

Boards:

Required properties:
- compatible: "brcm,bcm93384wvg", "brcm-bcm93384wvg-viper"

The experimental -viper variants are for running Linux on the BMIPS4355
cable modem CPU instead of the BMIPS5000 application processor.
```

## Documentation/devicetree/bindings/mips/brcm/soc.txt
```
* Broadcom cable/DSL/settop platforms

SoCs:

Required properties:
- compatible: "brcm,bcm3384", "brcm,bcm33843"
              "brcm,bcm3384-viper", "brcm,bcm33843-viper"
              "brcm,bcm6328", "brcm,bcm6368",
              "brcm,bcm7125", "brcm,bcm7346", "brcm,bcm7360",
              "brcm,bcm7420", "brcm,bcm7425"

Boards:

Required properties:
- compatible: "brcm,bcm93384wvg", "brcm,bcm93384wvg-viper"
              "brcm,bcm9ejtagprb", "brcm,bcm96368mvwg",
              "brcm,bcm97125cbmb", "brcm,bcm97346dbsmb", "brcm,bcm97360svmb",
              "brcm,bcm97420c", "brcm,bcm97425svmb"

The experimental -viper variants are for running Linux on the 3384's
BMIPS4355 cable modem CPU instead of the BMIPS5000 application processor.
```

## Documentation/devicetree/bindings/mips/brcm/usb.txt
```
* Broadcom USB controllers

Required properties:
- compatible: "brcm,bcm3384-ohci", "brcm,bcm3384-ehci"
- compatible: "brcm,bcm7346-ohci", "brcm,bcm7346-ehci"
- compatible: "brcm,bcm7425-ohci", "brcm,bcm7425-ehci"

  These currently use the generic-ohci and generic-ehci drivers.  On some
  systems, special handling may be needed in the following cases:

  - Restoring state after systemwide power save modes
  - Sharing PHYs with the USBD (UDC) hardware
  - Figuring out which controllers are disabled on ASIC bondout variants
```

## Documentation/devicetree/bindings/serial/mrvl-serial.txt
```
PXA UART controller

Required properties:
- compatible : should be "mrvl,mmp-uart", "mrvl,pxa-uart", or
  "brcm,bcm7401-uart".
- interrupts : a single interrupt specifier.
- clocks : phandle to a clock; used to compute the baud divisor.

Optional properties:
- fifo-size : defaults to 64 bytes.
- big-endian : always use BE register accesses.
- native-endian : use BE register accesses if the kernel was built for BE,
  otherwise use LE register accesses.

Example:

	clocks {
		#address-cells = <1>;
		#size-cells = <0>;

		uart_clk: uart_clk@0 {
			compatible = "fixed-clock";
			#clock-cells = <0>;
			clock-frequency = <81000000>;
		};
	};

	uart0: serial@10406900 {
		compatible = "brcm,bcm7401-upg-uart";
		reg = <0x10406900 0x20>;
		native-endian;
		fifo-size = <32>;
		interrupt-parent = <&periph_intc>;
		interrupts = <64>;
		clocks = <&uart_clk>;
	};
```

## arch/mips/configs/npm702_defconfig
```kconfig
CONFIG_SOC_JZ4770=y
CONFIG_JZ4770_NPM702=y
CONFIG_FORCE_MAX_ZONEORDER=13
CONFIG_HIGHMEM=y
CONFIG_HZ_100=y
CONFIG_PREEMPT=y
CONFIG_EXPERIMENTAL=y
CONFIG_SYSVIPC=y
CONFIG_LOG_BUF_SHIFT=16
CONFIG_RELAY=y
CONFIG_BLK_DEV_INITRD=y
CONFIG_ASHMEM=y
CONFIG_EMBEDDED=y
CONFIG_MODULES=y
CONFIG_MODULE_FORCE_LOAD=y
CONFIG_MODULE_UNLOAD=y
CONFIG_MODULE_FORCE_UNLOAD=y
# CONFIG_BLK_DEV_BSG is not set
# CONFIG_CORE_DUMP_DEFAULT_ELF_HEADERS is not set
CONFIG_WAKELOCK=y
CONFIG_PM_RUNTIME=y
CONFIG_NET=y
CONFIG_PACKET=y
CONFIG_UNIX=y
CONFIG_INET=y
CONFIG_IP_MULTICAST=y
CONFIG_IP_PNP=y
CONFIG_IP_PNP_DHCP=y
CONFIG_IP_PNP_BOOTP=y
# CONFIG_INET_XFRM_MODE_TRANSPORT is not set
# CONFIG_INET_XFRM_MODE_TUNNEL is not set
# CONFIG_INET_XFRM_MODE_BEET is not set
# CONFIG_INET_LRO is not set
CONFIG_IPV6=y
CONFIG_IPV6_MIP6=y
CONFIG_NETFILTER=y
CONFIG_NETFILTER_TPROXY=y
CONFIG_NETFILTER_XT_TARGET_CLASSIFY=y
CONFIG_NETFILTER_XT_TARGET_IDLETIMER=y
CONFIG_NETFILTER_XT_TARGET_MARK=y
CONFIG_NETFILTER_XT_TARGET_NFLOG=y
CONFIG_NETFILTER_XT_TARGET_NFQUEUE=y
CONFIG_NETFILTER_XT_TARGET_TPROXY=y
CONFIG_NETFILTER_XT_TARGET_TRACE=y
CONFIG_NETFILTER_XT_MATCH_COMMENT=y
CONFIG_NETFILTER_XT_MATCH_HASHLIMIT=y
CONFIG_NETFILTER_XT_MATCH_IPRANGE=y
CONFIG_NETFILTER_XT_MATCH_LENGTH=y
CONFIG_NETFILTER_XT_MATCH_LIMIT=y
CONFIG_NETFILTER_XT_MATCH_MAC=y
CONFIG_NETFILTER_XT_MATCH_MARK=y
CONFIG_NETFILTER_XT_MATCH_POLICY=y
CONFIG_NETFILTER_XT_MATCH_PKTTYPE=y
CONFIG_NETFILTER_XT_MATCH_QTAGUID=y
CONFIG_NETFILTER_XT_MATCH_QUOTA=y
CONFIG_NETFILTER_XT_MATCH_QUOTA2=y
CONFIG_NETFILTER_XT_MATCH_QUOTA2_LOG=y
CONFIG_NETFILTER_XT_MATCH_SOCKET=y
CONFIG_NETFILTER_XT_MATCH_STATISTIC=y
CONFIG_NETFILTER_XT_MATCH_STRING=y
CONFIG_NETFILTER_XT_MATCH_TIME=y
CONFIG_NETFILTER_XT_MATCH_U32=y
CONFIG_IP_NF_IPTABLES=y
CONFIG_IP_NF_MATCH_AH=y
CONFIG_IP_NF_MATCH_ECN=y
CONFIG_IP_NF_MATCH_TTL=y
CONFIG_IP_NF_FILTER=y
CONFIG_IP_NF_TARGET_REJECT=y
CONFIG_IP_NF_TARGET_REJECT_SKERR=y
CONFIG_IP_NF_TARGET_LOG=y
CONFIG_IP_NF_MANGLE=y
CONFIG_IP_NF_RAW=y
CONFIG_IP_NF_ARPTABLES=y
CONFIG_IP_NF_ARPFILTER=y
CONFIG_IP_NF_ARP_MANGLE=y
CONFIG_IP6_NF_IPTABLES=y
CONFIG_IP6_NF_TARGET_LOG=y
CONFIG_IP6_NF_FILTER=y
CONFIG_IP6_NF_TARGET_REJECT=y
CONFIG_IP6_NF_TARGET_REJECT_SKERR=y
CONFIG_IP6_NF_MANGLE=y
CONFIG_IP6_NF_RAW=y
CONFIG_BLK_DEV_LOOP=y
CONFIG_BLK_DEV_RAM=y
CONFIG_MISC_DEVICES=y
CONFIG_SCSI=y
CONFIG_BLK_DEV_SD=y
# CONFIG_SCSI_LOWLEVEL is not set
CONFIG_MD=y
CONFIG_BLK_DEV_DM=y
CONFIG_DM_CRYPT=y
CONFIG_DM_UEVENT=y
CONFIG_NETDEVICES=y
CONFIG_TUN=y
# CONFIG_NETDEV_1000 is not set
# CONFIG_NETDEV_10000 is not set
CONFIG_WIFI_BRCM=y
CONFIG_USB_NET_AX8817X=y
# CONFIG_USB_NET_AX88772A is not set
CONFIG_USB_NET_DM9601=y
CONFIG_USB_NET_QF9700=y
CONFIG_PPP=y
CONFIG_PPP_MULTILINK=y
CONFIG_PPP_FILTER=y
CONFIG_PPP_ASYNC=y
CONFIG_PPP_SYNC_TTY=y
CONFIG_PPP_DEFLATE=y
CONFIG_PPP_BSDCOMP=y
CONFIG_PPP_MPPE=y
CONFIG_PPPOE=y
CONFIG_PPPOLAC=y
CONFIG_PPPOPNS=y
# CONFIG_INPUT_MOUSEDEV is not set
CONFIG_INPUT_EVDEV=y
CONFIG_KEYBOARD_JZ_GPIO=y
# CONFIG_KEYBOARD_ATKBD is not set
# CONFIG_INPUT_MOUSE is not set
CONFIG_INPUT_TOUCHSCREEN=y
CONFIG_TOUCHSCREEN_LDWZIC=y
CONFIG_LDWZIC_MULTI_TOUCH=y
# CONFIG_SERIO_I8042 is not set
# CONFIG_VT is not set
CONFIG_LEGACY_PTY_COUNT=2
CONFIG_SERIAL_INGENIC=y
CONFIG_SERIAL_INGENIC_CONSOLE=y
# CONFIG_HW_RANDOM is not set
CONFIG_I2C=y
CONFIG_I2C0_JZ4770=y
CONFIG_I2C1_JZ4770=y
CONFIG_I2C2_JZ4770=y
CONFIG_I2C_GPIO=y
CONFIG_SENSORS_JZ_MMA8452=y
CONFIG_SENSORS_JZ_MMA8452_AS_INPUT=y
CONFIG_SENSORS_JZ_MMA8452_ORI=y
CONFIG_POWER_SUPPLY=y
CONFIG_BATTERY_JZ47XX=y
CONFIG_ACTBAT_ONLY_USB=y
CONFIG_PMU_ACT8600_SUPPORT=y
# CONFIG_HWMON is not set
CONFIG_VIVANTE_GPU=y
CONFIG_VIVANTE_GPU_GC860=y
CONFIG_FB=y
CONFIG_FB_FOREIGN_ENDIAN=y
CONFIG_JZSOC_BOOT_LOGO=y
CONFIG_FB_ANDROID_JZSOC=y
CONFIG_ANDROID_LCD_AT070TN93=y
CONFIG_JZ47XX_AOSDC=y
CONFIG_SOUND=y
CONFIG_SOUND_PRIME=y
CONFIG_OSS_OBSOLETE=y
CONFIG_SOUND_JZ_I2S=y
CONFIG_NO_DETECT=y
CONFIG_USB=y
CONFIG_USB_DEVICEFS=y
# CONFIG_USB_DEVICE_CLASS is not set
CONFIG_USB_SUSPEND=y
# CONFIG_USB_OTG_WHITELIST is not set
CONFIG_USB_MUSB_HDRC=y
CONFIG_USB_MUSB_OTG=y
CONFIG_USB_GADGET_MUSB_HDRC=y
CONFIG_MUSB_PIO_ONLY=y
CONFIG_USB_STORAGE=y
CONFIG_USB_STORAGE_DATAFAB=y
CONFIG_USB_STORAGE_FREECOM=y
CONFIG_USB_STORAGE_ISD200=y
CONFIG_USB_STORAGE_USBAT=y
CONFIG_USB_STORAGE_SDDR09=y
CONFIG_USB_STORAGE_SDDR55=y
CONFIG_USB_STORAGE_JUMPSHOT=y
CONFIG_USB_STORAGE_ALAUDA=y
CONFIG_USB_STORAGE_ONETOUCH=y
CONFIG_USB_STORAGE_KARMA=y
CONFIG_USB_STORAGE_CYPRESS_ATACB=y
CONFIG_USB_STORAGE_ENE_UB6250=y
CONFIG_USB_SERIAL=y
CONFIG_USB_SERIAL_GENERIC=y
CONFIG_USB_SERIAL_OPTION=y
CONFIG_USB_GADGET=y
CONFIG_USB_GADGET_VBUS_DRAW=500
CONFIG_USB_G_ANDROID=y
CONFIG_USB_SERIAL_NUM="Novo7 Paladin"
CONFIG_USB_NLUNS_NUM=3
CONFIG_USB_OTG_WAKELOCK=y
CONFIG_NOP_USB_XCEIV=y
CONFIG_MMC=y
CONFIG_MMC_UNSAFE_RESUME=y
# CONFIG_MMC_BLOCK_BOUNCE is not set
CONFIG_MSC0_JZ4770=y
CONFIG_MSC1_JZ4770=y
CONFIG_MSC1_SDIO_SUPPORT=y
CONFIG_MSC2_JZ4770=y
CONFIG_JZ4770_BOOT_FROM_MSC0=y
CONFIG_NEW_LEDS=y
CONFIG_LEDS_CLASS=y
CONFIG_SWITCH=y
CONFIG_RTC_CLASS=y
CONFIG_RTC_DRV_JZ4770=y
CONFIG_STAGING=y
CONFIG_ANDROID=y
CONFIG_ANDROID_BINDER_IPC=y
CONFIG_ANDROID_LOGGER=y
CONFIG_ANDROID_RAM_CONSOLE=y
CONFIG_ANDROID_TIMED_GPIO=y
CONFIG_ANDROID_LOW_MEMORY_KILLER=y
CONFIG_EXT4_FS=y
CONFIG_FUSE_FS=y
CONFIG_CUSE=y
CONFIG_MSDOS_FS=y
CONFIG_VFAT_FS=y
CONFIG_PROC_KCORE=y
CONFIG_TMPFS=y
CONFIG_MINIX_FS=y
CONFIG_CIFS=y
CONFIG_CIFS_STATS=y
CONFIG_CIFS_WEAK_PW_HASH=y
CONFIG_CIFS_XATTR=y
CONFIG_CIFS_POSIX=y
CONFIG_PARTITION_ADVANCED=y
CONFIG_BSD_DISKLABEL=y
CONFIG_MINIX_SUBPARTITION=y
CONFIG_SOLARIS_X86_PARTITION=y
CONFIG_UNIXWARE_DISKLABEL=y
CONFIG_NLS_DEFAULT="cp437"
CONFIG_NLS_CODEPAGE_437=y
CONFIG_NLS_CODEPAGE_936=y
CONFIG_NLS_ASCII=y
CONFIG_NLS_ISO8859_1=y
CONFIG_MAGIC_SYSRQ=y
CONFIG_CRYPTO_SHA256=y
CONFIG_CRYPTO_AES=y
CONFIG_CRYPTO_TWOFISH=y
# CONFIG_CRYPTO_ANSI_CPRNG is not set
CONFIG_LIBCRC32C=y
```
